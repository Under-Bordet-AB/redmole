## components/gui/Kconfig
```kconfig
menu "RedMole GUI Configuration"

    config REDMOLE_GUI_THEME_HELLO_KITTY
        bool "Enable Hello Kitty theme"
        default y
        help
            Build the Hello Kitty theme assets and expose the theme in the UI.

    config REDMOLE_GUI_THEME_TERMINAL
        bool "Enable Terminal theme"
        default y
        help
            Build the Terminal theme assets and expose the theme in the UI.

    config REDMOLE_GUI_THEME_DEATH_NOTE
        bool "Enable Death Note theme"
        default y
        help
            Build the Death Note theme assets and expose the theme in the UI.

    config REDMOLE_GUI_THEME_SPONGEBOB
        bool "Enable SpongeBob theme"
        default y
        help
            Build the SpongeBob theme assets and expose the theme in the UI.

endmenu
```

## components/http_client/Kconfig
```kconfig
menu "RedMole HTTP Client"

    config REDMOLE_HTTP_POLL_INTERVAL_MS
        int "API poll interval (ms)"
        default 10000
        help
            How often the HTTP client polls the remote API in milliseconds.

    config REDMOLE_HTTP_RESPONSE_BUF_SIZE
        int "Size of response buffer (bytes)"
        default 10240
        help
            How big the buffer used for storing the response.json string should be

endmenu
```

## components/wifi/Kconfig
```kconfig
menu "RedMole WiFi Configuration"

    config REDMOLE_WIFI_SSID
        string "WiFi SSID"
        default "network"
        help
            SSID for the RedMole to connect to.

    config REDMOLE_WIFI_PASSWORD
        string "WiFi Password"
        default "network_password"
        help
            WiFi password (WPA or WPA2) for the RedMole to use.

    choice REDMOLE_WIFI_SAE_MODE
        prompt "WPA3 SAE mode selection"
        default REDMOLE_WPA3_SAE_PWE_BOTH
        help
            Select mode for SAE as Hunt and Peck, H2E or both.

        config REDMOLE_WPA3_SAE_PWE_HUNT_AND_PECK
            bool "HUNT AND PECK"
        config REDMOLE_WPA3_SAE_PWE_HASH_TO_ELEMENT
            bool "H2E"
            depends on ESP_WIFI_ENABLE_SAE_H2E
        config REDMOLE_WPA3_SAE_PWE_BOTH
            bool "BOTH"
            depends on ESP_WIFI_ENABLE_SAE_H2E
    endchoice

    config REDMOLE_WIFI_PW_ID
        string "PASSWORD IDENTIFIER"
        depends on REDMOLE_WPA3_SAE_PWE_HASH_TO_ELEMENT || REDMOLE_WPA3_SAE_PWE_BOTH
        default ""
        help
            Password identifier for SAE H2E.

    config REDMOLE_MAXIMUM_RETRY
        int "Maximum retry"
        default 5
        help
            Set the Maximum retry to avoid station reconnecting to the AP infinitely.

    choice REDMOLE_WIFI_AUTH_MODE_THRESHOLD
        prompt "WiFi Scan auth mode threshold"
        default REDMOLE_AUTH_WPA2_PSK
        help
            The weakest authmode to accept in the scan mode.

        config REDMOLE_AUTH_OPEN
            bool "OPEN"
        config REDMOLE_AUTH_WEP
            bool "WEP"
        config REDMOLE_AUTH_WPA_PSK
            bool "WPA PSK"
        config REDMOLE_AUTH_WPA2_PSK
            bool "WPA2 PSK"
        config REDMOLE_AUTH_WPA_WPA2_PSK
            bool "WPA/WPA2 PSK"
        config REDMOLE_AUTH_WPA3_PSK
            bool "WPA3 PSK"
        config REDMOLE_AUTH_WPA2_WPA3_PSK
            bool "WPA2/WPA3 PSK"
        config REDMOLE_AUTH_WAPI_PSK
            bool "WAPI PSK"
    endchoice

endmenu
```
